## firmware/main/Kconfig.projbuild
```kconfig
menu "SynthDef diagnostics"
    config SYNTHDEF_VOICE_PE
        bool "Nabu Casa Voice PE (48 kHz slave I2S)"
        default n
    config SYNTHDEF_VOICE_PE_LOW_RATE
        bool "Experimental 16 kHz Voice PE synthesis (filtered 48 kHz output)"
        depends on SYNTHDEF_VOICE_PE
        default n
        help
            Main and FX run at 16 kHz, with 4 ms control blocks. A fixed
            polyphase FIR converts stereo output to the existing 48 kHz XMOS
            link. Rings requires at least 32 kHz and is rejected in this mode.
    config SYNTHDEF_VOICE_PE_NATIVE_16K
        bool "Native 16 kHz Voice PE output (requires matching custom XMOS)"
        depends on SYNTHDEF_VOICE_PE && !SYNTHDEF_VOICE_PE_LOW_RATE
        default n
        help
            This needs a matching 16 kHz XMOS image and codec divider profile.
            Do not use with the stock 48 kHz XMOS clock configuration.
    config SYNTHDEF_NO_DISPLAY
        bool
        default y if SYNTHDEF_HEADLESS || SYNTHDEF_VOICE_PE
        default n
    config SYNTHDEF_HEADLESS
        bool "Seeed XIAO ESP32-S3 headless stereo I2S target"
        default n
    config SYNTHDEF_XIAO_NATIVE_16K
        bool "Native 16 kHz XIAO output (PCM5102A, experimental)"
        depends on SYNTHDEF_HEADLESS && !SYNTHDEF_VOICE_PE
        default n
        help
            Main and FX run at 16 kHz with 64-frame (4 ms) control blocks.
            The I2S master uses 32-bit slots carrying 16-bit PCM, providing
            the 64-fs BCLK required by PCM5102A's three-wire PLL at 16 kHz.
            No XMOS image or MCLK wire is involved. Rings is not admitted.
    config SYNTHDEF_I2S_BCLK
        int "Headless I2S bit clock GPIO"
        depends on SYNTHDEF_HEADLESS
        default 7
        range 0 48
    config SYNTHDEF_I2S_WS
        int "Headless I2S word select GPIO"
        depends on SYNTHDEF_HEADLESS
        default 8
        range 0 48
    config SYNTHDEF_I2S_DOUT
        int "Headless I2S data output GPIO"
        depends on SYNTHDEF_HEADLESS
        default 9
        range 0 48
    config SYNTHDEF_ANALOG_INPUTS
        bool "Enable XIAO D0/D1 analog inputs on control buses 8/9"
        depends on SYNTHDEF_HEADLESS
        default n
        help
            Enable only with connected 0..3.3 V controls. Unconnected inputs float.
            The BOOT button is always available on control bus 10.
    config SYNTHDEF_DIAGNOSTICS
        bool "Enable explicit muted benchmark and automated UI exercise commands"
        default n
    config SYNTHDEF_FM1_COMPAT
        bool "Enable software-validated FM1 compatibility profile"
        default n
        help
            Accept the complete pinned FM1 UGen/operator set and full graph
            capacities. Adds a 1 MiB PSRAM synth arena with incremental clearing.
            This experimental profile has no ESP32 real-time qualification.
    config SYNTHDEF_TOUCH_UI
        bool "Enable V2 touchscreen and four-control factory patch"
        depends on !SYNTHDEF_NO_DISPLAY
        default n
    config SYNTHDEF_OFFLINE_CAPTURE
        bool "Render the factory fixture offline, dump float output, and remain silent"
        default n
endmenu
```

## ports/voice_pe/main/Kconfig.projbuild
```kconfig
menu "Voice PE silent probe"
    config SYNTHDEF_FM1_COMPAT
        bool
        default y
    config SYNTHDEF_DIAGNOSTICS
        bool
        default n
endmenu
```

## ports/voice_pe/sdkconfig.defaults
```kconfig
CONFIG_IDF_TARGET="esp32s3"
CONFIG_ESPTOOLPY_FLASHMODE_DIO=y
CONFIG_ESPTOOLPY_FLASHSIZE_16MB=y
CONFIG_ESP_DEFAULT_CPU_FREQ_MHZ_240=y
CONFIG_SPIRAM=y
CONFIG_SPIRAM_MODE_OCT=y
CONFIG_SPIRAM_SPEED_80M=y
CONFIG_SPIRAM_USE_MALLOC=y
CONFIG_SPIRAM_MALLOC_RESERVE_INTERNAL=65536
CONFIG_ESP_CONSOLE_USB_SERIAL_JTAG=y
CONFIG_PARTITION_TABLE_CUSTOM=y
CONFIG_PARTITION_TABLE_CUSTOM_FILENAME="partitions.csv"
CONFIG_ESP_MAIN_TASK_STACK_SIZE=8192
CONFIG_COMPILER_OPTIMIZATION_PERF=y
CONFIG_FREERTOS_HZ=1000
CONFIG_SYNTHDEF_FM1_COMPAT=y
CONFIG_SYNTHDEF_INTERNAL_RINGS=y
CONFIG_SYNTHDEF_INTERNAL_KERNELS=y
CONFIG_SYNTHDEF_INTERNAL_ADAPTER=y
# This app never mounts or writes a filesystem/NVS and has no radio or OTA.
```
