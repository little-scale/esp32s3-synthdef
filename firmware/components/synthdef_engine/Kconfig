## firmware/components/synthdef_engine/Kconfig
```kconfig
menu "SynthDef memory placement"
    config SYNTHDEF_INTERNAL_VOICE_ARENA_SAMPLES
        int "Internal-memory arena for smaller stateful voices (float samples)"
        depends on SYNTHDEF_FM1_COMPAT
        range 0 16896
        default 0
        help
            Optionally reserves up to 66 KiB for voices whose state fits, including
            each non-compact Rings model. Larger voices keep the full 1 MiB
            PSRAM arena. No delay capacity or sample precision is reduced.
            Disabled by default; the measured gain is small relative to RAM cost.
    config SYNTHDEF_INTERNAL_RINGS
        bool "Keep Rings processing routines in internal instruction RAM"
        default y if SYNTHDEF_FM1_COMPAT
        default n
        help
            Places existing Rings code in internal instruction RAM without
            changing algorithms, table values, precision or string capacity.
    config SYNTHDEF_INTERNAL_ADAPTER
        bool "Keep audio control and PCM routines in internal instruction RAM"
        default y
        help
            Avoids flash instruction misses in the small per-block adapter.
            The sound algorithms and PCM rounding remain unchanged.
    config SYNTHDEF_INTERNAL_KERNELS
        bool "Keep admitted-voice rendering kernels in internal instruction RAM"
        default y
        help
            Avoids contention with display code for the flash instruction cache.
            Only linker placement changes; engine source and math stay pinned.
    config SYNTHDEF_INTERNAL_SINE
        bool "Keep the immutable sine lookup table in internal RAM"
        default n
        help
            Uses 32772 bytes of internal RAM to avoid flash data-cache misses
            in the admitted oscillator. No engine code or table bytes change.
endmenu
```

## firmware/main/Kconfig.projbuild
```kconfig
menu "SynthDef diagnostics"
    config SYNTHDEF_HEADLESS
        bool "Seeed XIAO ESP32-S3 headless stereo I2S target"
        default n
    config SYNTHDEF_I2S_BCLK
        int "Headless I2S bit clock GPIO"
        depends on SYNTHDEF_HEADLESS
        default 7
        range 0 48
    config SYNTHDEF_I2S_WS
        int "Headless I2S word select GPIO"
        depends on SYNTHDEF_HEADLESS
        default 8
        range 0 48
    config SYNTHDEF_I2S_DOUT
        int "Headless I2S data output GPIO"
        depends on SYNTHDEF_HEADLESS
        default 9
        range 0 48
    config SYNTHDEF_ANALOG_INPUTS
        bool "Enable XIAO D0/D1 analog inputs on control buses 8/9"
        depends on SYNTHDEF_HEADLESS
        default n
        help
            Enable only with connected 0..3.3 V controls. Unconnected inputs float.
            The BOOT button is always available on control bus 10.
    config SYNTHDEF_DIAGNOSTICS
        bool "Enable explicit muted benchmark and automated UI exercise commands"
        default n
    config SYNTHDEF_FM1_COMPAT
        bool "Enable software-validated FM1 compatibility profile"
        depends on SYNTHDEF_DIAGNOSTICS
        default n
        help
            Accept the complete pinned FM1 UGen/operator set and full graph
            capacities. Adds a 1 MiB PSRAM synth arena with incremental clearing.
            This experimental profile has no ESP32 real-time qualification.
    config SYNTHDEF_TOUCH_UI
        bool "Enable V2 touchscreen and four-control factory patch"
        depends on !SYNTHDEF_HEADLESS
        default n
    config SYNTHDEF_OFFLINE_CAPTURE
        bool "Render the factory fixture offline, dump float output, and remain silent"
        default n
endmenu
```

## firmware/sdkconfig.defaults
```kconfig
CONFIG_IDF_TARGET="esp32s3"
CONFIG_ESPTOOLPY_FLASHMODE_QIO=y
CONFIG_ESPTOOLPY_FLASHSIZE_16MB=y
CONFIG_ESP_DEFAULT_CPU_FREQ_MHZ_240=y
CONFIG_SPIRAM=y
CONFIG_SPIRAM_MODE_OCT=y
CONFIG_SPIRAM_SPEED_80M=y
CONFIG_SPIRAM_USE_MALLOC=y
CONFIG_SPIRAM_MALLOC_RESERVE_INTERNAL=65536
CONFIG_PARTITION_TABLE_CUSTOM=y
CONFIG_PARTITION_TABLE_CUSTOM_FILENAME="partitions.csv"
CONFIG_ESP_CONSOLE_USB_SERIAL_JTAG=y
CONFIG_FREERTOS_HZ=1000
CONFIG_COMPILER_OPTIMIZATION_PERF=y
CONFIG_ESP_MAIN_TASK_STACK_SIZE=6144
CONFIG_LV_COLOR_DEPTH_16=y
CONFIG_LV_COLOR_16_SWAP=y
CONFIG_LV_FONT_MONTSERRAT_22=y
CONFIG_LV_USE_SNAPSHOT=y
CONFIG_LV_DISP_DEF_REFR_PERIOD=40
CONFIG_LV_MEM_SIZE_KILOBYTES=64
CONFIG_LV_THEME_DEFAULT_GROW=n
CONFIG_LV_THEME_DEFAULT_TRANSITION_TIME=0
CONFIG_BSP_DISPLAY_LVGL_BUF_HEIGHT=20
CONFIG_SYNTHDEF_INTERNAL_KERNELS=y
CONFIG_SYNTHDEF_INTERNAL_ADAPTER=y
```
